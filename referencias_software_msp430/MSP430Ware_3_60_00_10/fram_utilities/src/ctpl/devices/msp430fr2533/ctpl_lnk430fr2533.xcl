// ************************************************
//
// XLINK configuration file for MSP430FR2533
//
// Copyright 1996-2015 Texas Instruments
//
// Version: 1.168
//
// ************************************************

// ---------------------------------------------------------
// Description
//

//
// Usage:
//
//   xlink [file file ...] -f lnk430fr2533.xcl
//
// -----------------------------------------------
// Device summary
//

//
// Core:                           MSP430Xv2
//
// Interrupt vectors:              60
//
// Signature memory:               8 Bytes
//
// Peripheral units:               0-0FFF
//
// Information memory (FRAM) :     1800 - 19FF
//
// Read/write memory (RAM):        2000 - 27FF
//
// Persistent memory(FRAM) :       C400 - FFFF
//                                 


// -----------------------------------------------
// Segments
//

// -------------------------------------
// Data read/write segments (RAM)
//

//
// segment         Usage
// -------         --------------------------
// DATA<nn>_Z      Data initialized to zero
// DATA<nn>_I      Data initialized by copying from DATA<nn>_ID
// DATA<nn>_N      Data defined using __no_init
// DATA<nn>_P      Data defined using __persistent
// DATA<nn>_HEAP   The heap used by 'malloc' and 'free'
// TLS16_I         Thread-local storage for main thread
//


// -----------------------------------------------
// Program and data read-only segments (FRAM) 
//

//
// segment         Usage
// -------         --------------------------
// DATA<nn>_C      Constant data, including string literals
// DATA<nn>_ID     Initializers for DATA<nn>_I
// INFO            Information memory
// INFOx           Information memory, bank x
// CSTART          Program startup code
// CODE            Program code
// ISR_CODE        Program code for interrupt service routines
// DIFUNCT         Dynamic initialization vector used by C++
// CHECKSUM        Checksum byte(s) generated by the -J option
// SIGNATURE       Signature memory
// INTVEC          Interrupt vectors
// RESET           The reset vector
// TLS16_ID        Thread-local initializers for main thread
//
// Notes:
//
// * The segments CSTART, ISR_CODE, and DIFUNCT, as well as the segments in
//   the DATA16 and TLS16 segment groups must be placed in in the range
//   0000-FFFD.
//
// * The INFOx and INFO segments overlap, this allows data either to be
//   placed in a specific bank or anywhere in the info memory.
//
// * The INTVEC and RESET segments overlap. This allows an application to
//   either use the reset vector provided by the runtime library, or
//   provide a reset function by defining an interrupt function associated
//   with the reset vector.
//


// -----------------------------------------------
// Configuation
//

// -----------------------------------------------
// Stack and heap sizes
//

// Uncomment for command line use
//-D_STACK_SIZE=160
//-D_DATA16_HEAP_SIZE=160
//-D_DATA20_HEAP_SIZE=160


// -----------------------------------------------
// Define cpu
//

-cmsp430


// -----------------------------------------------
// Support for placing functions in read/write memory
//

-QCODE_I=CODE_ID


// -----------------------------------------------
// Support for thread local storage
//

-QTLS16_I=TLS16_ID


// -----------------------------------------------
// Hardware multiplier location
//

-D__iar_HWMUL=4C0


// -----------------------------------------------
// Placement directives
//

// -----------------------------------------------
// Information memory
//

-Z(CONST)INFO=1800-19FF
-Z(CONST)INFOA=1800-19FF


// -----------------------------------------------
// RAM memory
//

-Z(DATA)CSTACK+_STACK_SIZE#2000-27FF


// -----------------------------------------------
// FRAM memory
//

// -------------------------------------
// Read/write data in FRAM
//

-Z(CONST)DATA16_P,DATA20_P=C400-FF7F
-Z(DATA)DATA16_I,DATA16_Z,DATA16_N,TLS16_I
-Z(DATA)CODE_I
-Z(DATA)DATA20_I,DATA20_Z,DATA20_N
-Z(DATA)DATA16_HEAP+_DATA16_HEAP_SIZE,DATA20_HEAP+_DATA20_HEAP_SIZE

// -----------------------------------------------
// Constant data
//

-Z(CONST)DATA16_C,DATA16_ID,TLS16_ID,DIFUNCT,CHECKSUM=C400-FF7F
-Z(CONST)DATA20_C,DATA20_ID

// -----------------------------------------------
// Code
//

-Z(CODE)CSTART,ISR_CODE,CODE_ID=C400-FF7F
-P(CODE)CODE,CODE16=C400-FF7F


// -------------------------------------
// Interrupt vectors
//

-Z(CONST)SIGNATURE=FF80-FF87
-Z(CONST)JTAGSIGNATURE=FF80-FF83
-Z(CONST)BSLSIGNATURE=FF84-FF87
-Z(CONST)JTAGPASSWORD=FF88-FF8B
-Z(CONST)IPESIGNATURE=FF88-FF8F
-Z(CODE)INTVEC=FF88-FFFF
-Z(CODE)RESET=FFFE-FFFF
